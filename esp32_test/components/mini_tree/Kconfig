## esp32_test/components/mini_tree/Kconfig
```kconfig
# mini_tree Kconfig for ESP-IDF (ESP32-S3)
# Lightweight: device tree + OSAL + bare metal only.
# All configuration options — edit .config or run `idf.py menuconfig`
# (navigate to Component config → mini_tree Configuration)

menu "mini_tree Configuration"

menu "Platform"
choice
    prompt "Target MCU"
    default PLATFORM_XTENSA
    help
      Select the target processor architecture.

config PLATFORM_XTENSA
    bool "Xtensa (ESP32)"
    help
      Espressif ESP32 series (Xtensa LX6/LX7).
endchoice
endmenu

menu "Multi-core Configuration"

config CPU_CORES
    int "Number of CPU cores"
    default 1
    range 1 2
    help
      CPU 核心数量。1 = 单核模式（默认）。
      2 = 双核 AMP 模式，Core 0 跑 RTOS，
      Core 1 跑裸机代码。
      设为 2 时板级需实现
      hal_cpu_secondary_startup()。

endmenu

menu "OSAL Backend"
choice
    prompt "RTOS backend"
    default OSAL_FREERTOS
    help
      Select the OS abstraction layer backend.

config OSAL_FREERTOS
    bool "FreeRTOS"
    help
      Use ESP-IDF built-in FreeRTOS.

config OSAL_RTTHREAD
    bool "RT-Thread"
    help
      Use RT-Thread kernel as OSAL backend.
      Note: RT-Thread kernel not bundled in this project;
      provide your own or delete this option.

config OSAL_NULL
    bool "None (bare-metal)"
    help
      No RTOS. Queue uses ring buffer + busy-wait.
endchoice
endmenu

menu "System Log"
choice
    prompt "Log backend"
    default SYS_LOG_USE_PRINTF
    help
      Select system log output backend.

config SYS_LOG_USE_PRINTF
    bool "Direct printf"
    help
      Output via plain printf.

config SYS_LOG_USE_OSAL
    bool "OSAL logging"
    help
      Output via OSAL log interface.

config SYS_LOG_USE_ESP
    bool "ESP-IDF logging (ESP_LOGI)"
    help
      Output via ESP-IDF's ESP_LOGI / ESP_LOGW / ESP_LOGE.
endchoice
endmenu

menu "System Backend"
choice
    prompt "System runtime implementation"
    default SYSTEM_CPP
    help
      Select C or C++ system backend.

config SYSTEM_C
    bool "C"
    help
      Pure C system runtime.

config SYSTEM_CPP
    bool "C++"
    help
      C++ system runtime (default for ESP-IDF IoT scenarios).
endchoice
endmenu

menu "Board Features"

config PRODUCTION_LOG
    bool "Production log"
    default n
    help
      Enable production-level logging.

config SAFETY_SHUTDOWN
    bool "Safety shutdown"
    default n
    help
      Enable hardware-level safety shutdown.

config ENABLE_WDT
    bool "Watchdog (TWDT + RTC WDT)"
    default y
    help
      Enable task watchdog and RTC watchdog.
endmenu

menu "Build Options"

config BUILD_DISASM
    bool "Generate disassembly listing"
    default n
    help
      Generate .lst disassembly listing after build.
endmenu

endmenu
```
